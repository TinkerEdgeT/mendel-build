## defconfig
```kconfig
CONFIG_IKCONFIG=y
CONFIG_TYPEC_TCPM=n
CONFIG_TYPEC_TCPCI=n
CONFIG_ANDROID_PARANOID_NETWORK=n
CONFIG_BRCMFMAC=n
CONFIG_BRCMFMAC_SDIO=n
CONFIG_BRCMUTIL=n
CONFIG_BUILD_ARM_APPENDED_DTB_IMAGE=n
CONFIG_KERNEL_GZIP=y
CONFIG_KERNEL_LZO=n
CONFIG_REGULATOR_BD71837=y
CONFIG_MFD_BD71837=y
CONFIG_LOG_BUF_SHIFT=17
CONFIG_WLAN=y
CONFIG_ATH10K=n

# QCACLD-2.0
CONFIG_CFG80211_INTERNAL_REGDB=y
CONFIG_CFG80211_WEXT=y
CONFIG_WIRELESS=y
CONFIG_WIRELESS_EXT=y
CONFIG_WEXT_CORE=y
CONFIG_WEXT_PROC=y
CONFIG_WEXT_PRIV=y
CONFIG_WEXT_SPY=y
CONFIG_QCA_CLD_WLAN=y
# CONFIG_CLD_HL_SDIO_CORE is not set
CONFIG_QCACLD_WLAN_LFR3=y
CONFIG_PRIMA_WLAN_OKC=y
CONFIG_PRIMA_WLAN_11AC_HIGH_TP=y
CONFIG_WLAN_FEATURE_11W=y
CONFIG_WLAN_FEATURE_LPSS=y
CONFIG_QCOM_VOWIFI_11R=y
CONFIG_WLAN_FEATURE_NAN=y
CONFIG_WLAN_FEATURE_NAN_DATAPATH=y
CONFIG_QCOM_TDLS=y
CONFIG_QCOM_LTE_COEX=y
CONFIG_WLAN_OFFLOAD_PACKETS=y
CONFIG_WLAN_FEATURE_MEMDUMP=y
CONFIG_WLAN_SYNC_TSF=y
# CONFIG_QCA_WIFI_AUTOMOTIVE_CONC is not set
# CONFIG_WLAN_UDP_RESPONSE_OFFLOAD is not set
# CONFIG_WLAN_WOW_PULSE is not set
# CONFIG_DPTRACE_ENABLE is not set

CONFIG_I2C=y
CONFIG_I2C_CHARDEV=y
CONFIG_SND_SOC_FSL_ASOC_CARD=y
CONFIG_SND_SOC_RT5645=y
CONFIG_SND_SOC_RT5631=y
CONFIG_SND_SOC_RL6231=y
CONFIG_MFD_BD71837=y
CONFIG_REGULATOR_BD71837=y
CONFIG_MXC_CAMERA_OV5645_MIPI_V2=y
CONFIG_SPI_IMX=y
# CONFIG_REGULATOR_ISL91301 is not set
CONFIG_PCIEASPM_POWER_SUPERSAVE=y
CONFIG_LOCALVERSION_AUTO=n
CONFIG_IMX8MQ_PHANBELL_POWERSAVE=y
CONFIG_DRM_PANEL_TIANMA_S6D6FP0A2=y
CONFIG_STAGING_GASKET_FRAMEWORK=y
CONFIG_STAGING_APEX_DRIVER=y
```
